## boards/arty_a735t/Kconfig
```kconfig
# Copyright (c) 2023 E.I.S
#
# This file is subject to the terms and conditions of the GNU Lesser
# General Public License v2.1. See the file LICENSE in the top level
# directory for more details.

config BOARD
    default "arty_a735t" if BOARD_ARTY_A735T

config BOARD_ARTY_A735T
    bool
    default y
    select CPU_MODEL_RISCV32IMC_EIS

    # Put defined MCU peripherals here (in alphabetical order)

    # Put other features for this board (in alphabetical order)
```
